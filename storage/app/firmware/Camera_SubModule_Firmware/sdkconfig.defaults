## storage/app/firmware/Camera_SubModule_Firmware/sdkconfig.defaults
```kconfig
# ESP32-S3 Camera SubModule - Default Configuration
# Target: XIAO ESP32-S3 Sense

# Target chip
CONFIG_IDF_TARGET="esp32s3"

# Flash configuration
CONFIG_ESPTOOLPY_FLASHSIZE_8MB=y
CONFIG_ESPTOOLPY_FLASHMODE_QIO=y
CONFIG_ESPTOOLPY_FLASHFREQ_80M=y

# Partition table
CONFIG_PARTITION_TABLE_CUSTOM=y
CONFIG_PARTITION_TABLE_CUSTOM_FILENAME="partitions.csv"

# PSRAM configuration (XIAO ESP32-S3 Sense has 8MB Octal PSRAM)
CONFIG_SPIRAM=y
CONFIG_SPIRAM_MODE_OCT=y
CONFIG_SPIRAM_SPEED_80M=y
CONFIG_SPIRAM_BOOT_INIT=y
CONFIG_SPIRAM_USE_MALLOC=y
CONFIG_SPIRAM_MALLOC_ALWAYSINTERNAL=4096
CONFIG_SPIRAM_MALLOC_RESERVE_INTERNAL=32768

# PSRAM pins for XIAO ESP32-S3 (Octal mode uses dedicated pins)
CONFIG_SPIRAM_FETCH_INSTRUCTIONS=y
CONFIG_SPIRAM_RODATA=y

# Camera configuration
CONFIG_CAMERA_CORE0=y
CONFIG_CAMERA_DMA_BUFFER_SIZE_MAX=32768

# FreeRTOS
CONFIG_FREERTOS_HZ=1000
CONFIG_FREERTOS_UNICORE=n

# Logging
CONFIG_LOG_DEFAULT_LEVEL_INFO=y
CONFIG_LOG_MAXIMUM_LEVEL_DEBUG=y

# Optimization
CONFIG_COMPILER_OPTIMIZATION_PERF=y

# SPI
CONFIG_SPI_SLAVE_ISR_IN_IRAM=y

# Heap
CONFIG_HEAP_POISONING_COMPREHENSIVE=n
CONFIG_HEAP_TRACING_OFF=y

# Watchdog
CONFIG_ESP_TASK_WDT_TIMEOUT_S=10
```

## storage/app/firmware/Main_Attendance_Time_Clock/sdkconfig.defaults.current_broken
```kconfig
# ESP32-P4 NFC Reader Configuration

# Target chip
CONFIG_IDF_TARGET="esp32p4"

# Flash configuration
CONFIG_ESPTOOLPY_FLASHSIZE_16MB=y
CONFIG_ESPTOOLPY_FLASHFREQ_80M=y
CONFIG_ESPTOOLPY_FLASHMODE_QIO=y

# Partition table
CONFIG_PARTITION_TABLE_CUSTOM=y
CONFIG_PARTITION_TABLE_CUSTOM_FILENAME="partitions.csv"
CONFIG_PARTITION_TABLE_OFFSET=0x8000

# Log configuration
CONFIG_LOG_DEFAULT_LEVEL_INFO=y
CONFIG_LOG_COLORS=y

# Serial/UART configuration for ESP32-P4
CONFIG_ESP_CONSOLE_USB_SERIAL_JTAG=y
CONFIG_ESP_CONSOLE_SECONDARY_USB_SERIAL_JTAG=y

# FreeRTOS
CONFIG_FREERTOS_WATCHPOINT_END_OF_STACK=y
CONFIG_FREERTOS_THREAD_LOCAL_STORAGE_POINTERS=1

# SPI
CONFIG_SPI_MASTER_IN_IRAM=y

# ESP32P4 CPU frequency
CONFIG_ESP_DEFAULT_CPU_FREQ_MHZ_240=y

# Memory
CONFIG_ESP_MAIN_TASK_STACK_SIZE=8192

# WiFi buffer configuration (required for ESP32-P4)
CONFIG_ESP_WIFI_STATIC_RX_BUFFER_NUM=10
CONFIG_ESP_WIFI_DYNAMIC_RX_BUFFER_NUM=32
CONFIG_ESP_WIFI_TX_BUFFER_TYPE=1
CONFIG_ESP_WIFI_DYNAMIC_TX_BUFFER_NUM=32
CONFIG_ESP_WIFI_DYNAMIC_RX_MGMT_BUF=0
CONFIG_ESP_WIFI_RX_MGMT_BUF_NUM_DEF=5
CONFIG_ESP_WIFI_AMPDU_TX_ENABLED=y
CONFIG_ESP_WIFI_AMPDU_RX_ENABLED=y
CONFIG_ESP_WIFI_ESPNOW_MAX_ENCRYPT_NUM=7
```

## storage/app/firmware/Old/p4_wifi_display/main/Kconfig.projbuild
```kconfig
menu "Example WiFi Configuration"

    config EXAMPLE_WIFI_SSID
        string "WiFi SSID"
        default "FBI_VAN"
        help
            SSID (network name) for the example to connect to.

    config EXAMPLE_WIFI_PASS
        string "WiFi Password"
        default "vodka.lime.shot"
        help
            WiFi password (WPA or WPA2) for the example to use.

endmenu
```

## storage/app/firmware/Old/p4_wifi_display/sdkconfig.defaults
```kconfig
# Target chip
CONFIG_IDF_TARGET="esp32p4"

# ==== WiFi Slave Configuration ====
CONFIG_SLAVE_IDF_TARGET_ESP32C6=y

# ==== Example Wi-Fi settings ====
CONFIG_EXAMPLE_WIFI_SSID="FBI_VAN"
CONFIG_EXAMPLE_WIFI_PASS="vodka.lime.shot"

# ==== BSP / LVGL sanity ====
CONFIG_LV_CONF_MINIMAL=n
CONFIG_LV_USE_LABEL=y
CONFIG_LV_USE_LOG=n
```

## storage/app/templates/esp32_p4_lvgl_test/sdkconfig.defaults
```kconfig
# ESP32-P4 Configuration
CONFIG_IDF_TARGET="esp32p4"

# FreeRTOS Configuration
CONFIG_FREERTOS_HZ=1000

# ESP32-P4 Function EV Board - 7" Display (1024x600)
CONFIG_BSP_DISPLAY_LVGL_BUF_HEIGHT=100
CONFIG_BSP_DISPLAY_LVGL_AVOID_TEAR=y

# LVGL Configuration
CONFIG_LV_COLOR_DEPTH_16=y
CONFIG_LV_COLOR_16_SWAP=n

# Enable commonly used LVGL fonts
CONFIG_LV_FONT_MONTSERRAT_12=y
CONFIG_LV_FONT_MONTSERRAT_14=y
CONFIG_LV_FONT_MONTSERRAT_16=y
CONFIG_LV_FONT_MONTSERRAT_18=y
CONFIG_LV_FONT_MONTSERRAT_20=y
CONFIG_LV_FONT_MONTSERRAT_22=y
CONFIG_LV_FONT_MONTSERRAT_24=y
CONFIG_LV_FONT_MONTSERRAT_26=y
CONFIG_LV_FONT_MONTSERRAT_28=y
CONFIG_LV_FONT_MONTSERRAT_30=y
CONFIG_LV_FONT_MONTSERRAT_32=y
CONFIG_LV_FONT_MONTSERRAT_34=y
CONFIG_LV_FONT_MONTSERRAT_36=y
CONFIG_LV_FONT_MONTSERRAT_38=y
CONFIG_LV_FONT_MONTSERRAT_40=y
CONFIG_LV_FONT_MONTSERRAT_42=y
CONFIG_LV_FONT_MONTSERRAT_44=y
CONFIG_LV_FONT_MONTSERRAT_46=y
CONFIG_LV_FONT_MONTSERRAT_48=y

# Compiler optimization
CONFIG_COMPILER_OPTIMIZATION_PERF=y

# Component config
CONFIG_ESP_SYSTEM_EVENT_TASK_STACK_SIZE=4096
CONFIG_ESP_MAIN_TASK_STACK_SIZE=8192

# Reduce log verbosity for better performance
CONFIG_LOG_DEFAULT_LEVEL_INFO=y

# Partition table
CONFIG_PARTITION_TABLE_CUSTOM=n
CONFIG_PARTITION_TABLE_SINGLE_APP_LARGE=y
```
